## projects/module-autoload/meta-embeddedville-product/conf/layer.conf
```bitbake
BBPATH .= ":${LAYERDIR}"
BBFILES += "${LAYERDIR}/recipes-*/*/*.bb ${LAYERDIR}/recipes-*/*/*.bbappend"
BBFILE_COLLECTIONS += "embeddedville-product"
BBFILE_PATTERN_embeddedville-product = "^${LAYERDIR}/"
BBFILE_PRIORITY_embeddedville-product = "8"
LAYERSERIES_COMPAT_embeddedville-product = "scarthgap styhead"
```
